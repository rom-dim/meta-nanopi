## conf/layer.conf
```bitbake
# We have a conf and classes directory, add to BBPATH
BBPATH .= ":${LAYERDIR}"

# We have recipes-* directories, add to BBFILES
BBFILES += "${LAYERDIR}/recipes-*/*/*.bb \
         ${LAYERDIR}/recipes-*/*/*.bbappend"

BBFILE_COLLECTIONS += "nanopi"
BBFILE_PATTERN_nanopi = "^${LAYERDIR}/"
BBFILE_PRIORITY_nanopi = "8"

LAYERVERSION_nanopi = "1"
LAYERSERIES_COMPAT_nanopi = " dunfell"

LAYERDEPENDS_nanopi = "core "


# Let us add layer-specific bbappends which are only applied when that
# layer is included in our configuration
#BBFILES += "${@' '.join('${LAYERDIR}/%s/recipes*/*/*.bbappend' % layer \
#               for layer in BBFILE_COLLECTIONS.split())}"
# Add layer-specific bb files too
#BBFILES += "${@' '.join('${LAYERDIR}/%s/recipes*/*/*.bb' % layer \
#               for layer in BBFILE_COLLECTIONS.split())}"

BBFILES_DYNAMIC += " \
    jakku-layer:${LAYERDIR}/dynamic-layers/jakku-layer/*/*/*.bb \
    jakku-layer:${LAYERDIR}/dynamic-layers/jakku-layer/*/*/*.bbappend \
 "
```

## conf/machine/include/sunxi.inc
```bitbake
SOC_FAMILY ??= ""
include conf/machine/include/soc-family.inc

# Sub-architecture support
MACHINE_SOCARCH_SUFFIX ?= ""

PREFERRED_PROVIDER_virtual/kernel ?= "linux-mainline"
PREFERRED_PROVIDER_virtual/bootloader ?= "u-boot"

KERNEL_IMAGETYPE ?= "zImage"


UBOOT_ENTRYPOINT ?= "0x40008000"
UBOOT_LOADADDRESS ?= "0x40008000"

SPL_BINARY ?= "u-boot-sunxi-with-spl.bin"

SERIAL_CONSOLE ?= "115200 ttyS0"
MACHINE_FEATURES ?= "alsa"
```

## conf/machine/nanopi-duo2.conf
```bitbake
#@TYPE: Machine
#@NAME: nanopi-duo2
#@DESCRIPTION: Machine configuration for the FriendlyARM NanoPi Duo2, based
# on the Allwinner H3 CPU.

require conf/machine/include/sun8i.inc

KERNEL_DEVICETREE = "sun8i-h3-nanopi-duo2.dtb"
UBOOT_MACHINE = "nanopi_neo_defconfig"

FIT_HASH_ALG = "crc32"
KERNEL_CLASSES += "kernel-fitimage"
KERNEL_IMAGETYPES = "fitImage"
```
